## boards/kkm/kkm_k7p/Kconfig.defconfig
```kconfig
# KKM S5 BCN board configuration

# Copyright (c) 2024 Blecon Ltd.
# SPDX-License-Identifier: Closed

if BOARD_KKM_K7P

config BT_CTLR
	default BT

endif # BOARD_KKM_K7P
```

## boards/kkm/kkm_s5_bcn/Kconfig.defconfig
```kconfig
# KKM S5 BCN board configuration

# Copyright (c) 2024 Blecon Ltd.
# SPDX-License-Identifier: Closed

if BOARD_KKM_S5_BCN

config BT_CTLR
	default BT

endif # BOARD_KKM_S5_BCN
```
